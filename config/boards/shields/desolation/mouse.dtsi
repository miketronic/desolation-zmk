#define ZMK_MOUSE_DEFAULT_MOVE_VAL 1200
#define ZMK_MOUSE_DEFAULT_SCRL_VAL 20

#include <dt-bindings/zmk/mouse.h>
#include <behaviors/mouse_keys.dtsi>

&mmv {
    acceleration-exponent = <1>;
    time-to-max-speed-ms = <500>;
    delay-ms = <0>;
};

&msc {
    acceleration-exponent = <1>;
    time-to-max-speed-ms = <40>;
    delay-ms = <0>;
};
